/dts-v1/;
/plugin/;

#include <dt-bindings/clock/qcom,gcc-kona.h>
#include <dt-bindings/clock/qcom,camcc-kona.h>
#include <dt-bindings/clock/qcom,rpmh.h>
#include <dt-bindings/interrupt-controller/arm-gic.h>

#include "kona-hdk.dtsi"

/ {
	model = "Qualcomm Technologies, Inc. kona HDK";
	compatible = "qcom,kona-hdk", "qcom,kona", "qcom,hdk";
	qcom,board-id = <0x01001F 0x01>;
};

#include <dt-bindings/interrupt-controller/irq.h>

&qupv3_se1_i2c {
	status = "ok";
	qcom,clk-freq-out = <400000>;
	bq25970@65 {
		compatible = "ti,bq2597x-master";
		reg = <0x65>;
		//interrupt-parent = <&tlmm>;
		//interrupts = <111 0>;
		ti,irq-gpio = <&tlmm 111 0>;													
		ti,bq2597x,bat-therm-disable;	
		ti,bq2597x,bus-therm-disable;	
		ti,bq2597x,die-therm-disable;	

		ti,bq2597x,bat-ovp-threshold = <4525>;
		ti,bq2597x,bat-ovp-alarm-threshold = <4500>;
		ti,bq2597x,bat-ocp-threshold = <8000>;
		ti,bq2597x,bat-ocp-alarm-threshold = <7500>;
		//for dual cp :
		ti,bq2597x,bat-ocp-disable;

		ti,bq2597x,bus-ovp-threshold = <12000>;
		ti,bq2597x,bus-ovp-alarm-threshold = <11000>;
		ti,bq2597x,bus-ocp-threshold = <3750>;
		ti,bq2597x,bus-ocp-alarm-threshold = <3500>;

		ti,bq2597x,bat-ucp-alarm-threshold = <2000>;

		ti,bq2597x,bat-therm-threshold = <0x15>;/*4.1%*/
		ti,bq2597x,bus-therm-threshold = <0x15>;/*4.1%*/
		ti,bq2597x,die-therm-threshold = <125>;

		ti,bq2597x,ac-ovp-threshold = <12>;
		ti,bq2597x,sense-resistor-mohm = <2>;
	};
	bq25970-slave@66 {
		compatible = "ti,bq2597x-slave";
		//compatible = "ti,bq2597x-standalone";
		reg = <0x66>;
		//interrupt-parent = <&tlmm>;
		//interrupts = <7 0>;
		ti,irq-gpio = <&tlmm 7 0>;													
		ti,bq2597x,bat-therm-disable;	
		ti,bq2597x,bus-therm-disable;	
		ti,bq2597x,die-therm-disable;	

		ti,bq2597x,bat-ovp-threshold = <4525>;
		ti,bq2597x,bat-ovp-alarm-threshold = <4500>;
		ti,bq2597x,bat-ocp-threshold = <8000>;
		ti,bq2597x,bat-ocp-alarm-threshold = <7500>;
		//for dual cp :
		ti,bq2597x,bat-ocp-disable;

		ti,bq2597x,bus-ovp-threshold = <12000>;
		ti,bq2597x,bus-ovp-alarm-threshold = <11000>;
		ti,bq2597x,bus-ocp-threshold = <3750>;
		ti,bq2597x,bus-ocp-alarm-threshold = <3500>;

		ti,bq2597x,bat-ucp-alarm-threshold = <2000>;

		ti,bq2597x,bat-therm-threshold = <0x15>;/*4.1%*/
		ti,bq2597x,bus-therm-threshold = <0x15>;/*4.1%*/
		ti,bq2597x,die-therm-threshold = <125>;

		ti,bq2597x,ac-ovp-threshold = <12>;
		ti,bq2597x,sense-resistor-mohm = <2>;
	};
};

