## drivers/power/bq2429x/Kconfig
```kconfig
config CHARGER_BQ2429X
	tristate "TI BQ2429X battery charger driver"
	depends on I2C
	default y
	help
	  Say Y to enable support for TI bq2429x charger
```

## drivers/power/bq24725a/Kconfig
```kconfig
config CHARGER_BQ24725
	tristate "TI BQ24725 battery charger driver"
	depends on I2C
	default y
	help
	  Say Y to enable support for TI bq24725 charger
```

## drivers/power/bq25600-slave/Kconfig
```kconfig
config CHARGER_BQ25600_SLAVE
	tristate "TI BQ25600 battery charger driver"
	depends on I2C
	default y
	help
	  Say Y to enable support for TI bq25600 as slave charger
```

## drivers/power/bq25606-slave/Kconfig
```kconfig
config CHARGER_BQ25606_SLAVE
	tristate "TI BQ25606 battery charger driver"
	depends on I2C
	default y
	help
	  Say Y to enable support for TI bq25606 as slave charger
```

## drivers/power/bq25700/Kconfig
```kconfig
config CHARGER_BQ25700
	tristate "TI BQ25700 buck-boost battery charger driver"
	depends on I2C
	default y
	help
	  Say Y to enable support for TI bq25700 charger
```

## drivers/power/bq2588x/Kconfig
```kconfig
config CHARGER_BQ2588X
	tristate "TI BQ2588X battery charger driver"
	depends on I2C
	default y
	help
	  Say Y to enable support for TI bq2588x charger
```

## drivers/power/bq25910-slave/Kconfig
```kconfig
config CHARGER_BQ25910_SLAVE
	tristate "TI BQ25910 battery charger driver"
	depends on I2C
	default y
	help
	  Say Y to enable support for TI bq25910 as slave charger
```

## drivers/power/bq2597x/Kconfig
```kconfig
config CHARGER_BQ2597X
	tristate "TI BQ2597X battery charger driver"
	depends on I2C
	default y
	help
	  Say Y to enable support for TI bq2597x charger
```

## drivers/power/bq25980-bq25790/Kconfig
```kconfig
menu "TI Technologies, Inc. Charger support"

config CHARGER_BQ25790
	tristate "TI BQ25790 battery charger driver"
	depends on I2C
	select REGMAP_I2C
	help
	  Say Y to enable support for the TI BQ25790 battery charger.


config CHARGER_BQ25980
	tristate "TI BQ25980 battery charger driver"
	depends on I2C
	depends on GPIOLIB || COMPILE_TEST
	select REGMAP_I2C
	help
	  Say Y to enable support for the TI BQ25980 battery charger.

endmenu
```

## drivers/power/bq27532/Kconfig
```kconfig
config FUEL_GAUGE_BQ27532
	tristate "TI BQ27532 battery charger driver"
	depends on I2C
	default y
	help
	  Say Y to enable support for TI bq27532 fuel gauge driver
```

## drivers/power/bq27z561/Kconfig
```kconfig
config FUEL_GAUGE_BQ27Z561
	tristate "TI bq27z561 battery gauge driver"
	depends on I2C
	default y
	help
	  Say Y to enable support for TI bq27z561 fuel gauge driver
```

## drivers/power/bq27z860/Kconfig
```kconfig
config FUEL_GAUGE_BQ27Z860
	tristate "TI bq27z860 battery gauge driver"
	depends on I2C
	default y
	help
	  Say Y to enable support for TI bq27z860 as slave charger
```

## drivers/power/bq28z610/Kconfig
```kconfig
config CHARGER_BQ28Z610
	tristate "TI BQ28Z610 battery charger driver"
	depends on I2C
	default y
	help
	  Say Y to enable support for TI bq28z610 charger
```

## drivers/power/bq34z100/Kconfig
```kconfig
config CHARGER_BQ34Z100
	tristate "TI BQ34Z100 battery gauge driver"
	depends on I2C
	default y
	help
	  Say Y to enable support for TI bq34z100 gauge driver
```

## drivers/power/bq40z50/Kconfig
```kconfig
config FUEL_GAUGE_BQ40Z50
	tristate "TI BQ40z50 battery charger driver"
	depends on I2C
	default y
	help
	  Say Y to enable support for TI bq40z50 fuel gauge driver
```
