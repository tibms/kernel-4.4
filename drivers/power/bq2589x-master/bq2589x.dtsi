&i2c_7 {
	status = "okay";
	bq25890@6A {
		compatible = "ti,bq2589x-1";
		reg = <0x6A>;

		#address-cells = <1>;
		#size-cells = <0>;
		interrupt-parent = <&tlmm>;
		interrupts = <42 2>;
		bq-gpio = <&tlmm 24 0>;
		ti,bq2589x,vbus-volt-high-level = <8700>;/* tune adapter to output 9v */
		ti,bq2589x,vbus-volt-low-level = <4400>;/* tune adapter to output 5v */
 		ti,bq2589x,vbat-min-volt-to-tuneup = <3000>;
		ti,bq2589x,charge-voltage = <4208>;
		ti,bq2589x,charge-current = <2000>;
		ti,bq2589x,term-current = <256>;
		ti,bq2589x,enable-auto-dpdm;
		ti,bq2589x,enable-termination;
		ti,bq2589x,enable-ico;
		ti,bq2589x,use-absolute-vindpm;
	};
};
