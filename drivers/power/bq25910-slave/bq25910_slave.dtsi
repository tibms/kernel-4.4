bq25910@4B {
			compatible = "ti,bq2591x";
			reg = <0x4B>;

			/*ti,bq2591x,enable-term;*/

			ti,bq2591x,charge-voltage = <4400>;
			ti,bq2591x,charge-current = <3000>;
			ti,bq2591x,input-current-limit = <3000>;
			ti,bq2591x,input-voltage-limit = <4500>;
			ti,bq2591x,vbatlow-volt = <3500>;
};
